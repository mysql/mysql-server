TRUNCATE TABLE t2;
INSERT INTO t2 (c1,c2,c3) VALUES ('a','b',4), ('a','b',2), ('b','b',3), ('a','c',4), ('a','d',5); 
INSERT INTO t2 (c1,c2,c3) VALUES ('b','b',1), ('b','a',4), ('b','c',6), ('b','e',4), ('b','z',5); 
INSERT INTO t2 (c1,c2,c3) VALUES ('c','b',5), ('c','c',7), ('c','c',4), ('c','d',9), ('c','f',4); 
INSERT INTO t2 (c1,c2,c3) VALUES ('a','c',4), ('a','c',2), ('c','b',3), ('a','c',4), ('a','d',5); 
INSERT INTO t2 (c1,c2,c3) VALUES ('b','c',1), ('b','a',4), ('b','c',6), ('b','e',4), ('b','z',5); 
INSERT INTO t2 (c1,c2,c3) VALUES ('c','c',5), ('c','c',7), ('c','c',4), ('c','d',9), ('c','f',4); 
INSERT INTO t2 (c1,c2,c3) VALUES ('a','b',3), ('a','b',2), ('b','b',3), ('a','c',3), ('a','d',5); 
INSERT INTO t2 (c1,c2,c3) VALUES ('b','b',1), ('b','a',3), ('b','c',6), ('b','e',3), ('b','z',5); 
INSERT INTO t2 (c1,c2,c3) VALUES ('c','b',5), ('c','c',7), ('c','c',3), ('c','d',9), ('c','f',3); 
INSERT INTO t2 (c1,c2,c3) VALUES ('a','c',3), ('a','c',2), ('c','b',3), ('a','c',3), ('a','d',5); 
INSERT INTO t2 (c1,c2,c3) VALUES ('b','c',1), ('b','a',3), ('b','c',6), ('b','e',3), ('b','z',5); 
INSERT INTO t2 (c1,c2,c3) VALUES ('c','c',5), ('c','c',7), ('c','c',3), ('c','d',9), ('c','f',3); 
INSERT INTO t2 (c1,c2,c3) VALUES ('a','b',2), ('a','b',2), ('b','b',3), ('a','c',2), ('a','d',5); 
INSERT INTO t2 (c1,c2,c3) VALUES ('b','b',1), ('b','a',2), ('b','c',6), ('b','e',2), ('b','z',5); 
INSERT INTO t2 (c1,c2,c3) VALUES ('c','b',5), ('c','c',7), ('c','c',2), ('c','d',9), ('c','f',2); 
INSERT INTO t2 (c1,c2,c3) VALUES ('a','c',2), ('a','c',2), ('c','b',3), ('a','c',2), ('a','d',5); 
INSERT INTO t2 (c1,c2,c3) VALUES ('b','c',1), ('b','a',2), ('b','c',6), ('b','e',2), ('b','z',5); 
INSERT INTO t2 (c1,c2,c3) VALUES ('c','c',5), ('c','c',7), ('c','c',2), ('c','d',9), ('c','f',2); 
INSERT INTO t2 (c1,c2,c3) VALUES ('a','b',1), ('a','b',2), ('b','b',3), ('a','c',1), ('a','d',5); 
INSERT INTO t2 (c1,c2,c3) VALUES ('b','b',1), ('b','a',1), ('b','c',6), ('b','e',1), ('b','z',5); 
INSERT INTO t2 (c1,c2,c3) VALUES ('c','b',5), ('c','c',7), ('c','c',1), ('c','d',9), ('c','f',1); 
INSERT INTO t2 (c1,c2,c3) VALUES ('a','c',1), ('a','c',2), ('c','b',3), ('a','c',1), ('a','d',5); 
INSERT INTO t2 (c1,c2,c3) VALUES ('b','c',1), ('b','a',1), ('b','c',6), ('b','e',1), ('b','z',5); 
INSERT INTO t2 (c1,c2,c3) VALUES ('c','c',5), ('c','c',7), ('c','c',1), ('c','d',9), ('c','f',1); 

