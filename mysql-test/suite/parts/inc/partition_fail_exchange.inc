SET SESSION debug="+d,exchange_partition_fail_1";
--source suite/parts/inc/partition_fail_t2.inc
SET SESSION debug="-d,exchange_partition_fail_1";
SET SESSION debug="+d,exchange_partition_fail_2";
--source suite/parts/inc/partition_fail_t2.inc
SET SESSION debug="-d,exchange_partition_fail_2";
SET SESSION debug="+d,exchange_partition_fail_3";
--source suite/parts/inc/partition_fail_t2.inc
SET SESSION debug="-d,exchange_partition_fail_3";
SET SESSION debug="+d,exchange_partition_fail_4";
--source suite/parts/inc/partition_fail_t2.inc
SET SESSION debug="-d,exchange_partition_fail_4";
SET SESSION debug="+d,exchange_partition_fail_5";
--source suite/parts/inc/partition_fail_t2.inc
SET SESSION debug="-d,exchange_partition_fail_5";
SET SESSION debug="+d,exchange_partition_fail_6";
--source suite/parts/inc/partition_fail_t2.inc
SET SESSION debug="-d,exchange_partition_fail_6";
SET SESSION debug="+d,exchange_partition_fail_7";
--source suite/parts/inc/partition_fail_t2.inc
SET SESSION debug="-d,exchange_partition_fail_7";
SET SESSION debug="+d,exchange_partition_fail_8";
--source suite/parts/inc/partition_fail_t2.inc
SET SESSION debug="-d,exchange_partition_fail_8";
SET SESSION debug="+d,exchange_partition_fail_9";
--source suite/parts/inc/partition_fail_t2.inc
SET SESSION debug="-d,exchange_partition_fail_9";
