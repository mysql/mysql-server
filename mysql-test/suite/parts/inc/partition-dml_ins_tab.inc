eval INSERT INTO $TABLENAME PARTITION (pNeg, subp0) VALUES (-4, '(pNeg-)subp0');
eval INSERT INTO $TABLENAME PARTITION (pNeg, subp0) VALUES (-3, '(pNeg-)subp0');
eval INSERT INTO $TABLENAME PARTITION (pNeg, subp0) VALUES (-2, '(pNeg-)subp0');
eval INSERT INTO $TABLENAME PARTITION (pNeg, subp0) VALUES (-1, '(pNeg-)subp0');

eval INSERT INTO $TABLENAME PARTITION (`p0-29`, subp3) VALUES (4, '(p0-29-)subp3');
eval INSERT INTO $TABLENAME PARTITION (`p0-29`, subp3) VALUES (3, '(p0-29-)subp3');
eval INSERT INTO $TABLENAME PARTITION (`p0-29`, subp3) VALUES (2, '(p0-29-)subp3');
eval INSERT INTO $TABLENAME PARTITION (`p0-29`, subp3) VALUES (1, '(p0-29-)subp3');

eval INSERT INTO $TABLENAME PARTITION (`p0-29`, subp5) VALUES (24, '(p0-29-)subp5');
eval INSERT INTO $TABLENAME PARTITION (`p0-29`, subp5) VALUES (23, '(p0-29-)subp5');
eval INSERT INTO $TABLENAME PARTITION (`p0-29`, subp5) VALUES (22, '(p0-29-)subp5');
eval INSERT INTO $TABLENAME PARTITION (`p0-29`, subp5) VALUES (21, '(p0-29-)subp5');

eval INSERT INTO $TABLENAME PARTITION (`p30-299`, subp9) VALUES (34, '(p30-299-)subp6');
eval INSERT INTO $TABLENAME PARTITION (`p30-299`, subp9) VALUES (33, '(p30-299-)subp6');
eval INSERT INTO $TABLENAME PARTITION (`p30-299`, subp9) VALUES (32, '(p30-299-)subp6');
eval INSERT INTO $TABLENAME PARTITION (`p30-299`, subp9) VALUES (31, '(p30-299-)subp6');

eval INSERT INTO $TABLENAME PARTITION (`p30-299`, subp8) VALUES (234, '(p30-299-)subp8');
eval INSERT INTO $TABLENAME PARTITION (`p30-299`, subp8) VALUES (233, '(p30-299-)subp8');
eval INSERT INTO $TABLENAME PARTITION (`p30-299`, subp8) VALUES (232, '(p30-299-)subp8');
eval INSERT INTO $TABLENAME PARTITION (`p30-299`, subp8) VALUES (231, '(p30-299-)subp8');

eval INSERT INTO $TABLENAME PARTITION (`p300-2999`, subp8) VALUES (304, '(p300-2999-)subp8');
eval INSERT INTO $TABLENAME PARTITION (`p300-2999`, subp8) VALUES (303, '(p300-2999-)subp8');
eval INSERT INTO $TABLENAME PARTITION (`p300-2999`, subp8) VALUES (302, '(p300-2999-)subp8');
eval INSERT INTO $TABLENAME PARTITION (`p300-2999`, subp8) VALUES (301, '(p300-2999-)subp8');

eval INSERT INTO $TABLENAME PARTITION (`p3000-299999`, subp12) VALUES (3004, '(p3000-299999-)subp12');
eval INSERT INTO $TABLENAME PARTITION (`p3000-299999`, subp12) VALUES (3003, '(p3000-299999-)subp12');
eval INSERT INTO $TABLENAME PARTITION (`p3000-299999`, subp12) VALUES (3002, '(p3000-299999-)subp12');
eval INSERT INTO $TABLENAME PARTITION (`p3000-299999`, subp12) VALUES (3001, '(p3000-299999-)subp12');

eval INSERT INTO $TABLENAME PARTITION (`p3000-299999`, subp14) VALUES (299996, '(p3000-299999-)subp14');
eval INSERT INTO $TABLENAME PARTITION (`p3000-299999`, subp14) VALUES (299997, '(p3000-299999-)subp14');
eval INSERT INTO $TABLENAME PARTITION (`p3000-299999`, subp14) VALUES (299998, '(p3000-299999-)subp14');
eval INSERT INTO $TABLENAME PARTITION (`p3000-299999`, subp14) VALUES (299999, '(p3000-299999-)subp14');

