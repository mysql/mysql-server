# Helper for hostcache_*.test

--echo "Dumping performance_schema.host_cache"

--disable_query_log
--vertical_results
select 
  IP, HOST, HOST_VALIDATED, SUM_CONNECT_ERRORS,
  COUNT_HOST_BLOCKED_ERRORS,
  COUNT_NAMEINFO_TRANSIENT_ERRORS,
  COUNT_NAMEINFO_PERMANENT_ERRORS,
  COUNT_FORMAT_ERRORS,
  COUNT_ADDRINFO_TRANSIENT_ERRORS,
  COUNT_ADDRINFO_PERMANENT_ERRORS,
  COUNT_FCRDNS_ERRORS,
  COUNT_HOST_ACL_ERRORS,
  COUNT_NO_AUTH_PLUGIN_ERRORS,
  COUNT_AUTH_PLUGIN_ERRORS,
  COUNT_HANDSHAKE_ERRORS,
  COUNT_PROXY_USER_ERRORS,
  COUNT_PROXY_USER_ACL_ERRORS,
  COUNT_AUTHENTICATION_ERRORS,
  COUNT_SSL_ERRORS,
  COUNT_MAX_USER_CONNECTIONS_ERRORS,
  COUNT_MAX_USER_CONNECTIONS_PER_HOUR_ERRORS,
  COUNT_DEFAULT_DATABASE_ERRORS,
  COUNT_INIT_CONNECT_ERRORS,
  COUNT_LOCAL_ERRORS,
  COUNT_UNKNOWN_ERRORS,
  if (FIRST_ERROR_SEEN is not null,
     if (FIRST_ERROR_SEEN > date("2012-01-01"), "set", "wrong epoch"),
     "null") as FIRST_ERROR_SEEN,
  if (LAST_ERROR_SEEN is not null,
     if (FIRST_ERROR_SEEN > date("2012-01-01"), "set", "wrong epoch"),
     "null") as LAST_ERROR_SEEN
  from performance_schema.host_cache;
--horizontal_results
--enable_query_log

