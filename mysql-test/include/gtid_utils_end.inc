# ==== Purpose ====
#
# Clean up what include/gtid_utils.inc created.
#
# ==== Usage ====
#
# See include/gtid_utils.inc

--let $include_filename= gtid_utils_end.inc
--source include/begin_include_file.inc

--disable_query_log
--let $gtid_utils_included=0

DROP FUNCTION GTID_IS_EQUAL;
DROP FUNCTION GTID_IS_DISJOINT;
DROP FUNCTION GTID_IS_DISJOINT_UNION;
DROP FUNCTION GTID_NORMALIZE;
DROP FUNCTION GTID_UNION;
DROP FUNCTION GTID_INTERSECTION;
DROP FUNCTION GTID_SYMMETRIC_DIFFERENCE;
DROP FUNCTION GTID_SUBTRACT_UUID;
DROP FUNCTION GTID_INTERSECTION_WITH_UUID;
DROP FUNCTION IFZERO;
DROP FUNCTION LOCATE2;
DROP FUNCTION GTID_COUNT;
DROP FUNCTION GTID_NEXT_GENERATED;
DROP FUNCTION GTID_NEXT_GENERATED_MULTIPLE;
DROP FUNCTION GTID_NEXT_GENERATED_SET;
DROP FUNCTION GTID_COMPARE;
DROP FUNCTION NUMBER_TO_UUID;
DROP FUNCTION UUID_TO_NUMBER;
DROP FUNCTION GTID_EXECUTED_FROM_TABLE;
DROP FUNCTION GTID_FROM_GTID_SET;

--let $include_filename= gtid_utils.inc
--source include/end_include_file.inc
