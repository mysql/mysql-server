insert into t1 values (_ucs2 0x0218), (_ucs2 0x0219), (_ucs2 0x021a), (_ucs2 0x021b);

insert into t1 values (_ucs2 0x0d96), (_ucs2 0x0da4), (_ucs2 0x0da5);

insert into t1 values (_ucs2 0x0064017e), (_ucs2 0x0044017e), (_ucs2 0x0044017d);
insert into t1 values ('CS'),('Cs'),('cs'),('cS');
insert into t1 values ('DZS'),('DZs'),('Dzs'),('DzS');
insert into t1 values ('dZS'),('dZs'),('dzs'),('dzS');
insert into t1 values ('GY'),('Gy'),('gy'),('gY');
insert into t1 values ('LY'),('Ly'),('ly'),('lY');
insert into t1 values ('NY'),('Ny'),('ny'),('nY');
insert into t1 values ('SZ'),('Sz'),('sz'),('sZ');
insert into t1 values ('TY'),('Ty'),('ty'),('tY');
insert into t1 values ('ZS'),('Zs'),('zs'),('zS');
insert into t1 values ('RR'),('Rr'),('rr'),('rR');
insert into t1 values ('ccs'),('Ccs'),('CCS'),('cCS');
insert into t1 values ('ddz'),('Ddz'),('DDZ'),('dDZ');
insert into t1 values ('ddzs'),('Ddzs'),('DDZS'),('dDZS');
insert into t1 values ('ggy'),('Ggy'),('GGY'),('gGY');
insert into t1 values ('lly'),('Lly'),('LLY'),('lLY');
insert into t1 values ('nny'),('Nny'),('NNY'),('nNY');
insert into t1 values ('ssz'),('Ssz'),('SSZ'),('sSZ');
insert into t1 values ('tty'),('Tty'),('TTY'),('tTY');
insert into t1 values ('zzs'),('Zzs'),('ZZS'),('zZS');
insert into t1 values ('UE'),('Ue'),('ue'),('uE');
